## drivers/battery/charger/pca9482_charger/Kconfig
```kconfig
config CHARGER_PCA9482
	tristate "PCA9482 charger driver"
	default n
	depends on DIRECT_CHARGING
	help
	  Say Y or M here,
	  to enable support for the PCA9482 charger.
	  This is 2:1 switched capacitor direct charger.
	  To compile the driver as a module, choose M here.

config SEND_PDMSG_IN_PPS_REQUEST_WORK_PCA9482
	bool "PCA9482 send pdmsg in request work"
	default n
	depends on CHARGER_PCA9482
	help
	  Say Y here to enable
	  support for send pdmsg in direct charger.
	  This options for pdic not support periodic send pdmsg.
	  If this is Y in direct charger, direct charger send pdmsg periodic.
```

## drivers/nfc/Kconfig
```kconfig
#
# near field communication configuration
#
config SAMSUNG_NFC
	tristate "Samsung NFC driver"
	default n
	help
	  Say Y here if you want to build support for NFC (Near field
	  communication) devices.
	  To compile this support as a module, choose M here: the module will
	  be called nfc.

config NFC_NXP_COMBINED
	bool "NXP COMBINED driver Feature"
	default n
	help
	  NXP Near Field Communication controller support.
	  If this feature is enabled, sn2xx driver can support various ICs
	  such as PN557, sn1xx and sn2xx.
	  For one binary, this driver should be used.

config NFC_SN2XX
	bool "NXP SN2XX Feature"
	default n
	help
	  NXP SN2XX Near Field Communication controller support
	  This option enables device driver support for the NFC.
	  It is used by many services. NFC is fully controlled using I2C
	  to communicate the AP chip.

config NFC_SN2XX_ESE_SUPPORT
	tristate "Nxp secure element protocol driver (SPI) devices"
	depends on SPI
	help
	  This enables the Secure Element driver for SNxxx based devices.
	  If unsure, say N.
	  This selects Secure Element support.
	  If you want NFC support, you should say Y here and
	  also to your specific host controller driver.

config ESE_USE_TZ_API
        bool "use tz api"
        depends on NFC_SN2XX_ESE_SUPPORT
        default n
        help
          Enable when using TZ API.
	  You should select this feature if your NFC product
          uses S.LSI AP and TZ API.
	  Say Y here to compile support for TZ API.

config CLK_ACPM_INIT
	bool "ACPM INIT"
	default n
	help
	  ACPM INIT must be called to use CLK3 in S5910.
```
